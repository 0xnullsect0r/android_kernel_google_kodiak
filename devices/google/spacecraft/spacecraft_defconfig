## devices/google/spacecraft/spacecraft_defconfig
```kconfig
# private/google-modules/touch/sec/p26/Kconfig
CONFIG_TOUCHSCREEN_SEC_TS=m
CONFIG_INPUT_POWER_KEYDEBUG=m
```

## devices/google/yogi/yogi_defconfig
```kconfig
CONFIG_COMMON_PANEL_TEST=m
CONFIG_DEBUG_PANEL_TEST=y
# private/google-modules/touch/sec/p26/Kconfig
CONFIG_TOUCHSCREEN_SEC_TS=m
CONFIG_INPUT_POWER_KEYDEBUG=m
```

## google-modules/bms/test/Kconfig
```kconfig
# SPDX-License-Identifier: GPL-2.0-or-later

config GOOGLE_TTF_TEST
	tristate "Google TTF test suite"
	depends on KUNIT
	default KUNIT_ALL_TESTS
	help
	  Enables KUnit unit testing for the TTF module in GBMS.
	  TTF calculates remaining charging duration using adapter power limits, battery
	  health status, SOC thresholds, and CCCM temperature tables. The test suite
	  validates SOC time estimation, battery current reductions, adapter power constraints,
	  and invalid input error handling. Say Y or M to build the test suite as `google_ttf_test`.
```

## google-modules/radio/mediatek/t900/wwan/tmi3/make/Kconfig
```kconfig
config MTK_WWAN_PWRCTL_SUPPORT
	bool "Enable MTK GPIO control from MTK PCIe driver"
	default n
	help
	  Enable the MTK PCIe host driver to call power control function
	  from the wwan_pwrctl driver. This is required to sync the reset
	  logic from PCIe and inform the wwan_pwrctl driver about the
	  power reset.

config MTK_HOST_DRV_WWAN_SUPPORT
	bool "Enable MTK WWAN support"
	default n
	help
	  Use the wwan functions instead of the generic cdev functions for
	  the supported /dev nodes.

config MTK_DATA_CPU_LOADING_OPTIMIZE
	bool "Enable AP optimizations for DPMAIF"
	default n
	help
	  Enable caching and CPU affinity for the data path (DPMAIF).

config MTK_DEVLINK
	bool "Enable devlink interface for MTK modem"
	default n
	help
	  Enable the devlink interface for the MTK modem. This maybe used
	  to expose things to the userspace that are not directly related
	  to a device class like char/wwan node, but rather the whole modem
	  itself.

config MTK_DEVLINK_COREDUMP_SUPPORT
	bool "Enable postdump support for MTK modem"
	select MTK_DEVLINK
	default n
	help
	  Enable the postdump support for MTK modem.

config MTK_DEVLINK_LOGDUMP_SUPPORT
	bool "Enable logdump from MTK modem"
	select MTK_DEVLINK
	default n
	help
	  Enable the logdump support from MTK modem.

config MTK_MEMLOG_EVENT_SUPPORT
	bool "Support memlog event in Thin MD host driver"
	default n
	help
	  Used to control the memlog event feature of the Thin MD host driver.
	  When this option is enabled, host driver will print
	  high-frequency logs in hex format.
	  The logs printed in hex format need to be parsed into
	  plain text using a post-processing tool.
	  Say Y here if need to enable memlog event in host driver.
	  If unsure, say N.

config GOOGLE_ASPM_CONTROL
	bool "Upstream style ASPM control"
	depends on ARCH_GOOGLE
	help
	  Replace vendor's direct register accesses with Linux standard API:
	  pci_enable_link_state. This ensures the driver following PCI spec
	  correctly and allows consistent system-wide policy to be overlaid
	  on top of any driver-specific requests.

config GOOGLE_ATR_WRITE_RETRY
	bool "ATR programming retry mitigation"
	depends on ARCH_GOOGLE
	help
	  Enable retry mechanism for ATR programming to mitigate the BAR2/3
	  access issue which may result in resume timeout or SRAMROM
	  violation.
	  See b/495424578 and b/507778536 for details.

config GOOGLE_LINK_DOWN_MMIO_PROTECT
	bool "Link down MMIO protection"
	depends on ARCH_GOOGLE
	help
	  Enable link checks in resume and REBOOTINT flow to avoid bus hang
	  when link up failed.
	  See b/496279367, b/496306491 and b/496959277 for details.

config GOOGLE_DIRECT_COMPLETE_SUPPORT
	bool "Support PCI direct-complete feature"
	depends on ARCH_GOOGLE
	default y
	help
	  Disable in-band PCIe wakeup to allow the PCI framework's
	  direct-complete feature to transition the device and its parents
	  into suspend state without running callbacks.

config GOOGLE_WWAN_PKT_PRIO
	bool "Google WWAN packet prioritization"
	depends on ARCH_GOOGLE
	help
	  Enable support for Google-specific WWAN packet prioritization
	  based on skb->mark bits 29 and 30. This is used by the
	  MediaTek WWAN driver.

config GOOGLE_B493109074_DEBUG
	bool "Dump more fields for seq num out-of-order issue"
	depends on ARCH_GOOGLE
	help
	  Dump more fields in addition to sequence number. This could help
	  us to understand the corrupted pattern further.
	  See b/493109074 for details.

config GOOGLE_B495424578_DEBUG
	bool "Dump ATR table for BAR2/3 access issue"
	depends on ARCH_GOOGLE
	help
	  Enable ATR table dump for BAR2/3 access issue.
	  See b/495424578 for details.

config GOOGLE_B503643353_DEBUG
	bool "Add verbose logging for usr_cnt of cldma1q4"
	depends on ARCH_GOOGLE
	help
	  Enable verbose logging for usr_cnt of cldma1q4.
	  See b/503643353 for details.

config GOOGLE_B507778536_DEBUG
	bool "MHCCIF link error reporting"
	depends on ARCH_GOOGLE
	help
	  Enable link error reporting when both MHCCIF stat and mask are
	  0xffffffff.
	  See b/507778536 for details.

config GOOGLE_B528903481_DEBUG
	bool "CLDMA/DPMAIF register dump for link error"
	depends on ARCH_GOOGLE
	help
	  Enable CLDMA/DPMAIF register dump when a link error is detected.
```

## google-modules/radio/mediatek/t900/wwan/tmi3/make/default_defconfig
```kconfig
# Keep sorted

#
# Vendor native features
#
CONFIG_MTK_DATA_CPU_LOADING_OPTIMIZE=y
CONFIG_MTK_DEVLINK=y
CONFIG_MTK_DEVLINK_LOGDUMP_SUPPORT=y
CONFIG_MTK_HOST_DRV_WWAN_SUPPORT=y
CONFIG_MTK_MEMLOG_EVENT_SUPPORT=y
CONFIG_MTK_WWAN_PWRCTL_SUPPORT=y
```

## google-modules/radio/mediatek/t900/wwan/tmi3/make/malibu_defconfig
```kconfig
# Keep sorted

#
# Vendor native features
#
CONFIG_MTK_DATA_CPU_LOADING_OPTIMIZE=y
CONFIG_MTK_DEVLINK=y
CONFIG_MTK_DEVLINK_LOGDUMP_SUPPORT=y
CONFIG_MTK_HOST_DRV_WWAN_SUPPORT=y
CONFIG_MTK_MEMLOG_EVENT_SUPPORT=y
CONFIG_MTK_WWAN_PWRCTL_SUPPORT=y

#
# Google customized features
#
CONFIG_GOOGLE_ASPM_CONTROL=y
CONFIG_GOOGLE_WWAN_PKT_PRIO=y

#
# Issue mitigation or workaround
#
CONFIG_GOOGLE_ATR_WRITE_RETRY=y
CONFIG_GOOGLE_LINK_DOWN_MMIO_PROTECT=y

#
# Debug patch
#
CONFIG_GOOGLE_B493109074_DEBUG=y
CONFIG_GOOGLE_B495424578_DEBUG=y
CONFIG_GOOGLE_B503643353_DEBUG=y
CONFIG_GOOGLE_B507778536_DEBUG=y
CONFIG_GOOGLE_B528903481_DEBUG=y
```

## google-modules/radio/mediatek/t900/wwan/tmi3/pcie/customize/google/Kconfig
```kconfig
# SPDX-License-Identifier: GPL-2.0-only

config GOOGLE_MD2AP_WAKEUP_MONITOR
	bool "MD-to-AP wakeup monitor"
	depends on ARCH_GOOGLE
	help
	  Enable MD-to-AP wakeup monitor feature to pinpoint wakeup
	  packet and expose the wakeup reason to user space via sysfs.

config GOOGLE_MODEM_CDD
	bool "Crash Debug Dump reporting"
	depends on GOOGLE_CRASH_DEBUG_DUMP
	help
	  Enable modem status reporting for Crash Debug Dump feature.
	  This can provide a quick glance of modem status when device
	  enters ramdump mode.

config GOOGLE_MODEM_DATA_AFFINITY
	bool "Google custom CPU affinity"
	depends on GOOGLE_MODEM_DATA_EXT
	help
	  Use Google's custom CPU affinity tables instead of vendor defaults.
	  Includes a runtime size check to ensure safety.

config GOOGLE_MODEM_DATA_EXT
	bool "Google data plane extensions"
	depends on ARCH_GOOGLE
	default y
	help
	  Gatekeeping option for all Google-specific data plane
	  enhancements.

config GOOGLE_MODEM_DATA_FAST_DMA_SYNC
	bool "Fast DMA sync optimization"
	depends on GOOGLE_MODEM_DATA_EXT
	help
	  Enable fast DMA sync when the page address is already known.

config GOOGLE_MODEM_DATA_LRO_SIZE_LIMIT
	bool "Limit RX LRO packets max size"
	depends on GOOGLE_MODEM_DATA_EXT
	help
	  Limit max Large Receive Offload (LRO) size to avoid
	  skb_over_panic on certain network device (e.g. USB NCM).

config GOOGLE_MODEM_SOC_BW_QOS
	bool "Modem SoC QoS for DDR bandwidth"
	depends on GOOGLE_IRM
	depends on GOOGLE_MODEM_DATA_EXT
	help
	  Enable SoC QoS and DDR bandwidth voting.
```

## google-modules/radio/mediatek/t900/wwan/tmi3/pcie/customize/google/malibu_defconfig
```kconfig
# Keep sorted
CONFIG_GOOGLE_MD2AP_WAKEUP_MONITOR=y
CONFIG_GOOGLE_MODEM_CDD=y
CONFIG_GOOGLE_MODEM_DATA_AFFINITY=y
CONFIG_GOOGLE_MODEM_DATA_EXT=y
CONFIG_GOOGLE_MODEM_DATA_FAST_DMA_SYNC=y
CONFIG_GOOGLE_MODEM_DATA_LRO_SIZE_LIMIT=y
CONFIG_GOOGLE_MODEM_SOC_BW_QOS=y
```
